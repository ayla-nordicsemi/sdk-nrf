## lib/user_app_jwt/Kconfig
```kconfig
#
# Copyright (c) 2024 Nordic Semiconductor ASA
#
# SPDX-License-Identifier: LicenseRef-Nordic-5-Clause
#

menuconfig USER_APP_JWT
	bool "User Application JWT Library"
	select BASE64
	select CJSON_LIB
	# needed to print integer values in json
	select CBPRINTF_FP_SUPPORT

if USER_APP_JWT

config JWT_VERIFY_SIGNATURE
	bool "Verify signature after signing"
	default y

config PRINT_EXPORTED_PUBKEY_DER
	bool "Print to terminal the DER formatted public key"
	default y

config USER_APP_JWT_MAX_LEN
	int "Buffer size to allocate for JWT"
	default 900
	help
	  Minimum JWT response is ~470 bytes.

config USER_APP_JWT_LOG_LEVEL
	int "logging level for JWT generation"
	default 3
	help
	  Set the logging level for JWT generation.

module=USER_APP_JWT
module-str=User App JWT

endif # USER_APP_JWT
```

## samples/sdfw/ssf_client/boards/nrf9280pdk_nrf9280_cpuapp.conf
```kconfig
# PSA configuration
CONFIG_NRF_SECURITY=y

# Enable Cracen PSA crypto drivers
CONFIG_PSA_CRYPTO_DRIVER_CRACEN=y
CONFIG_PSA_CRYPTO_DRIVER_CC3XX=n
CONFIG_PSA_CRYPTO_DRIVER_OBERON=n

# Enable PSA crypto from SSF client
CONFIG_PSA_SSF_CRYPTO_CLIENT=y
CONFIG_SSF_PSA_CRYPTO_SERVICE_ENABLED=y

# Disable Data Cache
CONFIG_DCACHE=n
```
